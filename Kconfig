## Kconfig
```kconfig
# SPDX-License-Identifier: MIT

config NOCFREE_KSCAN_PCA9555
    bool "NocFree PCA9555 key-input scanner"
    default y
    depends on DT_HAS_NOCFREE_KSCAN_PCA9555_ENABLED
    select I2C
    select KSCAN
    select ZMK_DEBOUNCE
    help
      Poll PCA9555-compatible I2C expanders that are wired as independent key
      inputs and report them through ZMK's KSCAN interface.

      The driver owns the expander registers directly instead of layering on
      Zephyr's generic PCA GPIO driver. See docs/architecture.md for why that
      is required on the ZMK-pinned Zephyr revision.

if NOCFREE_KSCAN_PCA9555

config NOCFREE_KSCAN_PCA9555_INIT_PRIORITY
    int "NocFree PCA9555 scanner init priority"
    default 90
    help
      Must be later than CONFIG_I2C_INIT_PRIORITY so the bus is available when
      the scanner writes and verifies the expander configuration.

config NOCFREE_KSCAN_PCA9555_STACK_SIZE
    int "NocFree PCA9555 scan thread stack size"
    default 1024
    help
      Stack for the dedicated scan queue. The scan itself is shallow; the depth
      is the synchronous I2C transfer.

config NOCFREE_KSCAN_PCA9555_PRIORITY
    int "NocFree PCA9555 scan thread priority"
    default 4
    help
      Preemptible priority for the scan queue. Scanning must not run on the
      cooperative system work queue, where each blocking expander read would
      delay the key events the scan has just produced and, on a split central,
      the events arriving from the peripheral.

endif # NOCFREE_KSCAN_PCA9555

config NOCFREE_SCALED_LED
    bool "Per-device brightness scale in front of another LED device"
    default y
    depends on DT_HAS_NOCFREE_SCALED_LED_ENABLED
    select LED
    help
      Forward LED brightness to another LED device with a fixed multiplier.

      ZMK sends one brightness value to every half of a split keyboard. The two
      halves of this board do not reach the same brightness at the same duty, so
      the per-half correction is applied in the LED device instead.

if NOCFREE_SCALED_LED

config NOCFREE_SCALED_LED_INIT_PRIORITY
    int "Scaled LED init priority"
    default 99
    help
      Must be later than CONFIG_LED_INIT_PRIORITY so the target device exists.

endif # NOCFREE_SCALED_LED

config NOCFREE_RECOVERY_CDC_1200_TOUCH
    bool "Enter the preserved UF2 bootloader when CDC baud is set to 1200"
    default y
    depends on USB_CDC_ACM && CDC_ACM_DTE_RATE_CALLBACK_SUPPORT
    depends on DT_HAS_ZEPHYR_CDC_ACM_UART_ENABLED
    depends on RETENTION_BOOT_MODE
    help
      Provide the conventional 1200-baud touch recovery trigger on a USB CDC
      interface. Unlike the keymap's &bootloader binding -- which acts on the
      half whose key triggered it and, for a split peripheral, needs a working
      split link -- this path only needs USB, so it recovers a half no matter
      what state its radio or pairing is in.

config NOCFREE_BEHAVIOR_BATTERY_REPORT
    bool "Type the battery level out as keystrokes"
    default y
    depends on DT_HAS_NOCFREE_BEHAVIOR_BATTERY_REPORT_ENABLED
    depends on ZMK_BATTERY_REPORTING
    help
      Bind this to a key to have the battery percentage typed as "bat NN".

      USB HID has no battery channel, so a level published as a BLE service is
      measured but invisible to a host on a cable. The factory firmware typed
      it out for the same reason. A ZMK macro cannot do this: macros send a
      sequence fixed at compile time, and the percentage is a runtime value.
```

## dts/bindings/behavior/nocfree,behavior-battery-report.yaml
```yaml
# Copyright (c) 2026 The NocFree ZMK Contributors
# SPDX-License-Identifier: MIT

description: |
  Types the battery state of charge out as keystrokes.

  USB HID has no battery channel, so a level published over BLE is invisible
  to a host on a cable. This types it instead, as "bat NN".

  Output is restricted to digits, letters and space, which occupy the same
  positions on ANSI and German ISO; punctuation is not layout-stable.

compatible: "nocfree,behavior-battery-report"

include: zero_param.yaml

properties:
  tap-ms:
    type: int
    default: 15
    description: |
      Milliseconds between the queued taps. Matches ZMK's macro default.
```

## dts/bindings/led/nocfree,scaled-led.yaml
```yaml
# SPDX-License-Identifier: MIT

description: |
  A LED device that forwards to another LED device with a fixed per-device
  scale applied to the brightness.

  The two halves of this keyboard do not reach the same brightness at the same
  PWM duty: part of the difference is supply voltage (a half on USB is brighter
  than one on battery) and part remains at equal supply, which is a property of
  the LED string itself. ZMK sends both halves one brightness value and has no
  per-half adjustment, so the correction has to live in the LED device.

  Child nodes mirror the target's children one for one; ZMK derives its LED
  count from DT_NUM_CHILD of the chosen backlight node.

compatible: "nocfree,scaled-led"

include: base.yaml

properties:
  target:
    type: phandle
    required: true
    description: The LED device this one forwards to.

  scale-percent:
    type: int
    required: true
    description: |
      Brightness multiplier in percent. 100 forwards unchanged, 70 makes this
      half dimmer, 150 makes it brighter. The scaled value is clamped to 100,
      so a scale above 100 compresses the top of the range rather than
      extending it.

child-binding:
  description: One entry per LED of the target device.
  properties: {}
```
